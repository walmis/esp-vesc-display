## main/Kconfig.projbuild
```kconfig
menu "Project Configuration"

choice ESP_VESC_CONN
    prompt "Vesc Connection"
    default ESP_VESC_STA

config ESP_VESC_UART
    bool "UART"
config ESP_VESC_STA
    bool "WIFI STA"
endchoice


if ESP_VESC_UART
config ESP_UART_BAUD
    int "Baudrate"
    default 230400
    help
	Vesc Connection Baudrate
endif

if ESP_VESC_STA
config ESP_WIFI_SSID
    string "WiFi SSID"
    default "auto"
    help
	SSID (network name) for ap and sta modes.
	auto - generates name automatically when in ap mode using mac address for ex. blackmagic_27FCF5E

config ESP_WIFI_PASSWORD
    string "WiFi Password"
    default "helloworld"
    help
	WiFi password (WPA or WPA2) for the example to use.
endif

if !ESP_VESC_STA

config ESP_AP_MODE
    bool "Wifi AP Bridge"

if ESP_AP_MODE
config ESP_AP_SSID
    string "WiFi AP SSID"
    default "ESP-VESC"
    help
	WiFi password (WPA or WPA2) for the example to use.
	
config ESP_AP_PSK
    string "WiFi AP Password"
    default "helloworld"
    help
	WiFi password (WPA or WPA2) for the example to use.
endif
endif

choice ESP_TFT
    prompt "TFT Display type"
    default ESP_TFT_ILI9225

config ESP_TFT_ILI9225
    bool "ILI9225 176x220"
config ESP_TFT_ILI9341
    bool "ILI9341 240x320"
endchoice


menu "Display GPIOs"    
config GPIO_TFT_RST
    int "TFT RST GPIO"
    default 0

config GPIO_TFT_DC
    int "TFT DC GPIO"
    default 15

config GPIO_TFT_CS
    int "TFT CS GPIO"
    default 2

config GPIO_TFT_LED
    int "TFT LED GPIO"
    default 4
endmenu

config DISPLAY_ROTATION
    int "Display Rotation"
    default 0
    
menu "Button GPIOs"    
config GPIO_BTN_UP
    int "UP Button GPIO"
    default -1
config GPIO_BTN_DN
    int "DOWN Button GPIO"
    default -1
config GPIO_BTN_ENT
    int "ENTER Button GPIO"
    default -1
endmenu
    
config LCD_TOUCH
    bool "Use Touchscreen (XPT2046)"

if LCD_TOUCH
config GPIO_TOUCH_CS
    int "Touch CS GPIO"
    default 5

config GPIO_TOUCH_IRQ
    int "Touch IRQ GPIO"
    default 4
endif

endmenu
```
